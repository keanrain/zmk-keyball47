## config/boards/shields/keyball_nano/Kconfig.shield
```kconfig
config SHIELD_KEYBALL47_LEFT
    def_bool $(shields_list_contains,keyball47_left)

config SHIELD_KEYBALL47_RIGHT
    def_bool $(shields_list_contains,keyball47_right)
```
